## components/concierge/Kconfig
```kconfig
menu "Concierge Companion"

    config CONCIERGE_ENABLE
        bool "Connect the agent to the Hotel Concierge"
        default y
        help
            Adds the ask_concierge function and swaps the persona's identity and
            boundaries blocks for the concierge versions. Off builds the upstream
            dg-agent behaviour unchanged.

    config CONCIERGE_BASE_URL
        string "Concierge base URL (first-boot seed)"
        depends on CONCIERGE_ENABLE
        default ""
        help
            The concierge Web app's public HTTPS origin, for example the Aspire
            api-tunnel URL (https://<id>-<port>.<region>.devtunnels.ms). No
            trailing path. Same precedence rule as the API key: a value saved
            through the setup portal wins over this one.

    config CONCIERGE_GUEST_LAST_NAME
        string "Guest last name (first-boot seed)"
        depends on CONCIERGE_ENABLE
        default ""

    config CONCIERGE_GUEST_ROOM
        string "Guest room number (first-boot seed)"
        depends on CONCIERGE_ENABLE
        default ""
        help
            1-4 digits, no leading zero, matching the concierge's RoomNumberFormat.

    config CONCIERGE_TURN_TIMEOUT_MS
        int "Concierge turn timeout (ms)"
        depends on CONCIERGE_ENABLE
        range 5000 60000
        default 25000
        help
            How long ask_concierge waits for POST /api/concierge/turns. Voice turns
            have been measured at up to ~17 s end to end (concierge ADR 0008), so
            this leaves margin without letting a dead tunnel hang the turn.

    config CONCIERGE_HOLD_DELAY_MS
        int "Say a hold line when a desk call is still pending after (ms)"
        depends on CONCIERGE_ENABLE
        range 500 10000
        default 2500
        help
            Measured from the FunctionCallRequest, which itself comes ~0.6 s
            after the guest stops speaking. A desk answer faster than this gets
            no filler at all. At 1500 every desk call on the bench qualified
            (1.7-4.5 s on gpt-5-mini over weak Wi-Fi) and one line started
            0.17 s before its answer, which then waited for it. Raise it if
            lines still start just before answers.

    config CONCIERGE_HOLD_LONG_MS
        int "Say one still-waiting line when a desk call is pending after (ms)"
        depends on CONCIERGE_ENABLE
        range 2000 30000
        default 8000

    config CONCIERGE_RECOVERY_MS
        int "After the agent promises to check, wait this long for a call (ms)"
        depends on CONCIERGE_ENABLE
        range 300 5000
        default 1200
        help
            If an agent turn says it will check and no function call arrives
            within this long after it finishes speaking, the device nudges it
            to ask the desk with the guest's last words.

endmenu
```
